## lib/sbi/Kconfig
```kconfig
# SPDX-License-Identifier: BSD-2-Clause

menu "Generic SBI Support"

config PMP_VIRT_SEAL
	bool "Experimental fixed-layout single-hart PMP.Virt sealing"
	default n


config PMP_VIRT_TRANSPORT_TEST
	bool "Experimental PMP.Virt RWX catch-all transport test"
	default n
	help
	  Research test for QEMU virt with x-pmp-virt enabled, RV64, one hart,
	  and Smepmp disabled. Attach the local PMP bit 6 to an existing
	  unlocked RWX catch-all and verify pmp_set/pmp_get readback. This
	  retains RWX, does not seal a protection policy, and does not detect
	  hardware support. Never enable this as a production security policy.

config CONSOLE_EARLY_BUFFER_SIZE
	int "Early console buffer size (bytes)"
	default 256

config SBI_ECALL_TIME
	bool "Timer extension"
	default y

config SBI_ECALL_RFENCE
	bool "RFENCE extension"
	default y

config SBI_ECALL_IPI
	bool "IPI extension"
	default y

config SBI_ECALL_HSM
	bool "Hart State Management extension"
	default y

config SBI_ECALL_SRST
	bool "System Reset extension"
	default y

config SBI_ECALL_SUSP
	bool "System Suspend extension"
	default y

config SBI_ECALL_PMU
	bool "Performance Monitoring Unit extension"
	default y

config SBI_ECALL_DBCN
	bool "Debug Console extension"
	default y

config SBI_ECALL_CPPC
	bool "CPPC extension"
	default y

config SBI_ECALL_FWFT
	bool "Firmware Feature extension"
	default y

config SBI_ECALL_LEGACY
	bool "SBI v0.1 legacy extensions"
	default y

config SBI_ECALL_VENDOR
	bool "Platform-defined vendor extensions"
	default y

config SBI_ECALL_DBTR
	bool "Debug Trigger Extension"
	default y

config SBIUNIT
	bool "Enable SBIUNIT tests"
	default n

config SBI_ECALL_SSE
	bool "SSE extension"
	default y

config SBI_ECALL_MPXY
	bool "MPXY extension"
	default y
endmenu
```
